## ports/esp32/sdkconfig.defaults
```kconfig
CONFIG_COMPILER_CXX_EXCEPTIONS=y
CONFIG_FREERTOS_USE_TICKLESS_IDLE=n
CONFIG_ESPTOOLPY_FLASHSIZE_16MB=y
CONFIG_ESPTOOLPY_FLASHSIZE="16MB"
CONFIG_ESP_CONSOLE_UART_DEFAULT=n
CONFIG_ESP_CONSOLE_USB_SERIAL_JTAG=y
CONFIG_PARTITION_TABLE_CUSTOM=y
CONFIG_PARTITION_TABLE_CUSTOM_FILENAME="partitions_golden.csv"
CONFIG_BOOTLOADER_APP_ROLLBACK_ENABLE=y

# Civilian no-RF/no-network baseline
CONFIG_ESP_WIFI_ENABLED=n
CONFIG_ESP32_WIFI_ENABLED=n
CONFIG_ESP_WIFI_ENABLE_WPA3_SAE=n
CONFIG_ESP_WIFI_ENABLE_SAE_PK=n
CONFIG_ESP_WIFI_ENABLE_WPA3_OWE_STA=n
CONFIG_ESP_WIFI_STA_DISCONNECTED_PM_ENABLE=n
CONFIG_ESP_WIFI_GMAC_SUPPORT=n
CONFIG_ESP_WIFI_SOFTAP_SUPPORT=n
CONFIG_ESP_WIFI_MBEDTLS_CRYPTO=n
CONFIG_ESP_WIFI_MBEDTLS_TLS_CLIENT=n
CONFIG_ESP_WIFI_ENTERPRISE_SUPPORT=n
CONFIG_ESP_PHY_ENABLED=n
CONFIG_ESP_COEX_ENABLED=n
CONFIG_ETH_ENABLED=n
CONFIG_LWIP_ENABLE=n

# Disable TLS transport layers in baseline profile
CONFIG_ESP_TLS_USING_MBEDTLS=n
CONFIG_MBEDTLS_TLS_ENABLED=n
CONFIG_ESP_HTTP_CLIENT_ENABLE_HTTPS=n
```
